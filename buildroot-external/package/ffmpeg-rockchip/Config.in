## buildroot-external/package/ffmpeg-rockchip/Config.in
```kconfig
config BR2_PACKAGE_FFMPEG_ROCKCHIP
	bool "ffmpeg-rockchip"
	depends on !BR2_PACKAGE_FFMPEG
	depends on BR2_aarch64
	depends on BR2_INSTALL_LIBSTDCPP # librga
	depends on BR2_TOOLCHAIN_USES_GLIBC # librga
	select BR2_PACKAGE_ROCKCHIP_MPP
	select BR2_PACKAGE_LIBRGA
	select BR2_PACKAGE_LIBDRM
	help
	  Rockchip-patched FFmpeg (nyanmisaka fork) with native RKMPP
	  codecs (h264_rkmpp/hevc_rkmpp/...), DRM PRIME zero-copy and
	  RGA-accelerated scaling/format conversion. Requires the kernel
	  MPP/RGA drivers and librockchip_mpp/librga.

	  Mutually exclusive with the stock Buildroot ffmpeg package: both
	  install /usr/bin/ffmpeg and libav*.so, so they cannot coexist.
	  (HAOS base images ship no ffmpeg, so this is the only one.)

	  https://github.com/nyanmisaka/ffmpeg-rockchip
```

## buildroot-external/package/librga/Config.in
```kconfig
config BR2_PACKAGE_LIBRGA
	bool "librga"
	depends on BR2_aarch64
	depends on BR2_INSTALL_LIBSTDCPP
	depends on BR2_TOOLCHAIN_USES_GLIBC
	help
	  Rockchip Raster Graphic Acceleration (RGA) userspace library
	  (prebuilt aarch64). Drives RGA2/RGA3 2D acceleration
	  (blit/scale/convert/csc) via /dev/rga. Used by ffmpeg-rockchip.

	  https://github.com/airockchip/librga
```

## buildroot-external/package/librknnrt/Config.in
```kconfig
config BR2_PACKAGE_LIBRKNNRT
	bool "librknnrt"
	depends on BR2_aarch64
	depends on BR2_INSTALL_LIBSTDCPP
	depends on BR2_TOOLCHAIN_USES_GLIBC
	help
	  Rockchip RKNN runtime (librknnrt.so) for the RK3588 NPU.
	  Prebuilt aarch64 library plus C API headers from airockchip
	  rknn-toolkit2. Requires the rknpu kernel driver (/dev/rknpu).

	  https://github.com/airockchip/rknn-toolkit2
```

## buildroot-external/package/rknpu/Config.in
```kconfig
config BR2_PACKAGE_RKNPU
	bool "rknpu (Rockchip RK3588 NPU, mainline)"
	depends on BR2_LINUX_KERNEL
	depends on BR2_aarch64
	help
	  Clean-room out-of-tree RKNPU kernel driver for RK3588 that
	  builds directly against mainline Linux (validated on 6.18/7.x).
	  Provides /dev/rknpu, 3-core concurrency, 800MHz devfreq and
	  per-core IOMMU isolation. Pairs with the librknnrt runtime.

	  Binds the mainline "rockchip,rk3588-rknn-core" DT nodes, which
	  the Rock 5B board DT already enables. The in-tree Rocket driver
	  (CONFIG_DRM_ACCEL_ROCKET) binds the same nodes and must stay off.

	  https://github.com/lurenJBD/rk3588-rknn-core
```

## buildroot-external/package/rockchip-mpp/Config.in
```kconfig
config BR2_PACKAGE_ROCKCHIP_MPP
	bool "rockchip-mpp"
	select BR2_PACKAGE_LIBDRM
	help
	  Rockchip Media Process Platform (MPP) userspace library
	  (librockchip_mpp). Talks to the kernel /dev/mpp_service driver
	  for RK3588 hardware video encode/decode (VEPU580/VDPU381/AV1).

	  https://github.com/rockchip-linux/mpp
```
