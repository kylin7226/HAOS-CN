## buildroot-external/Config.in
```kconfig
# HAOS-CN external packages
source "$BR2_EXTERNAL_HASSOS_PATH/package/ap6236_firmware/Config.in"
source "$BR2_EXTERNAL_HASSOS_PATH/package/ap6256_firmware/Config.in"
source "$BR2_EXTERNAL_HASSOS_PATH/package/matter/Config.in"
source "$BR2_EXTERNAL_HASSOS_PATH/package/rknpu/Config.in"
```

## buildroot-external/package/rknpu/Config.in
```kconfig
config BR2_PACKAGE_RKNPU
	bool "rknpu"
	help
	  Out-of-tree kernel module for the Rockchip RKNPU driver,
	  ported from the rockchip-linux/kernel.
	  Enables NPU hardware on Rockchip SoCs (RK3566/RK3568)
	  when using a mainline kernel.

	  https://github.com/w568w/rknpu-module
```
